## CMakeLists.txt
```
cmake_minimum_required(VERSION 3.20.0)
find_package(Zephyr REQUIRED HINTS $ENV{ZEPHYR_BASE})
project(app LANGUAGES C)

target_sources(app PRIVATE src/main.c)
```

## west.yml
```
# West manifest (T2 topology): this directory is the manifest repo; Zephyr and
# the HAL modules are cloned as siblings by `west update`. Every module you do
# not list here is a clone you do not wait for — trim the allowlist to your chips.
manifest:
  remotes:
    - name: zephyrproject-rtos
      url-base: https://github.com/zephyrproject-rtos

  projects:
    - name: zephyr
      remote: zephyrproject-rtos
      # Keep in step with the zephyr-nix pin nix-labs uses for the Python environment.
      revision: v4.3.0
      import:
        name-allowlist:
          - cmsis
          - cmsis_6
          - hal_nordic # nRF52/53/54
          - hal_stm32 # STM32
          - hal_rpi_pico # RP2040 / RP2350
          - hal_espressif # ESP32 family (large; drop if unused)
          - mbedtls
          - picolibc
          - segger
          - zcbor

  self:
    path: app
```

## prj.conf
```kconfig
# Kconfig for the application. Hello world only needs the console.
CONFIG_PRINTK=y
CONFIG_CONSOLE=y
```

## src/main.c
```c
/* Hello world: prove the toolchain, board and console work. */
#include <zephyr/kernel.h>
#include <zephyr/sys/printk.h>

int main(void)
{
	unsigned int n = 0;

	while (1) {
		printk("hello from %s (%u)\n", CONFIG_BOARD_TARGET, n++);
		k_sleep(K_SECONDS(1));
	}

	return 0;
}
```
